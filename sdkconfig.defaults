## sdkconfig.defaults
```kconfig
# Common defaults for all targets

# Compiler options
CONFIG_COMPILER_OPTIMIZATION_SIZE=y
CONFIG_COMPILER_OPTIMIZATION_ASSERTIONS_SILENT=y

# Partition table
CONFIG_PARTITION_TABLE_CUSTOM=y
CONFIG_PARTITION_TABLE_CUSTOM_FILENAME="partitions.csv"
CONFIG_PARTITION_TABLE_FILENAME="partitions.csv"

# FreeRTOS
CONFIG_FREERTOS_HZ=1000

# Log output
CONFIG_LOG_DEFAULT_LEVEL_INFO=y
CONFIG_LOG_MAXIMUM_LEVEL_VERBOSE=y

# Zigbee
CONFIG_ZB_ENABLED=y
CONFIG_ZB_RADIO_NATIVE=y
CONFIG_ZB_ZED_MAX_CHILD_NUMBER=10

# Enable RMT for LED strips
CONFIG_RMT_ISR_IRAM_SAFE=y
CONFIG_RMT_ENABLE_DEBUG_LOG=n
```

## sdkconfig.defaults.esp32c6
```kconfig
#
# ESP32-C6 specific defaults (LED Controller C6 variant)
#

#
# Partition Table
#
CONFIG_PARTITION_TABLE_CUSTOM_FILENAME="partitions_c6.csv"

#
# Flash Size (16MB on nanoESP32-C6)
#
CONFIG_ESPTOOLPY_FLASHSIZE_16MB=y
CONFIG_ESPTOOLPY_FLASHSIZE="16MB"

#
# WiFi (C6 only - needed for web configuration UI)
#
CONFIG_ESP_WIFI_ENABLED=y

#
# HTTP server WebSocket support
#
CONFIG_HTTPD_WS_SUPPORT=y

#
# WiFi + Zigbee coexistence
#
CONFIG_ESP_COEX_ENABLED=y
CONFIG_ESP_COEX_SW_COEXIST_ENABLE=y

#
# Flash chip support (nanoESP32-C6 uses Boya flash)
#
CONFIG_SPI_FLASH_SUPPORT_BOYA_CHIP=y
```

## sdkconfig.defaults.esp32h2
```kconfig
# ESP32-H2 specific configuration

# IEEE 802.15.4 (Zigbee radio)
CONFIG_IEEE802154_ENABLED=y

# Main XTAL frequency
CONFIG_XTAL_FREQ_32=y

# Sleep
CONFIG_PM_ENABLE=n
```
